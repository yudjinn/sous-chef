## tests/fixtures/ws/meta-core/conf/layer.conf
```bitbake
# Stand-in for OE-Core's layer configuration.
BBPATH .= ":${LAYERDIR}"

BBFILES += "${LAYERDIR}/recipes-*/*/*.bb \
            ${LAYERDIR}/recipes-*/*/*.bbappend"

BBFILE_COLLECTIONS += "core"
BBFILE_PATTERN_core = "^${LAYERDIR}/"
BBFILE_PRIORITY_core = "5"

LAYERVERSION_core = "15"
LAYERSERIES_CORENAMES = "scarthgap styhead"
LAYERSERIES_COMPAT_core = "scarthgap styhead"
```

## tests/fixtures/ws/meta-mine/conf/layer.conf
```bitbake
BBPATH .= ":${LAYERDIR}"

BBFILES += "${LAYERDIR}/recipes-*/*/*.bb \
            ${LAYERDIR}/recipes-*/*/*.bbappend"

BBFILE_COLLECTIONS += "mine"
BBFILE_PATTERN_mine = "^${LAYERDIR}/"
BBFILE_PRIORITY_mine = "10"

LAYERDEPENDS_mine = "core"
LAYERSERIES_COMPAT_mine = "kirkstone scarthgap wrynose"
```

## tests/fixtures/ws/meta-vendor/conf/layer.conf
```bitbake
BBPATH .= ":${LAYERDIR}"

BBFILES += "${LAYERDIR}/recipes-*/*/*.bb \
            ${LAYERDIR}/recipes-*/*/*.bbappend"

BBFILE_COLLECTIONS += "vendor"
BBFILE_PATTERN_vendor = "^${LAYERDIR}/"
BBFILE_PRIORITY_vendor = "6"

LAYERDEPENDS_vendor = "core"
LAYERSERIES_COMPAT_vendor = "scarthgap wrynose"
```
