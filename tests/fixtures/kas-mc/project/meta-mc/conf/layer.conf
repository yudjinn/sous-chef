## tests/fixtures/kas-mc/project/meta-mc/conf/layer.conf
```bitbake
BBPATH .= ":${LAYERDIR}"

BBFILES += "${LAYERDIR}/recipes-*/*/*.bb"

BBFILE_COLLECTIONS += "mc"
BBFILE_PATTERN_mc = "^${LAYERDIR}/"
BBFILE_PRIORITY_mc = "6"

LAYERSERIES_COMPAT_mc = "wrynose"
```

## tests/fixtures/kas/checkout/openembedded-core/meta/conf/layer.conf
```bitbake
BBPATH .= ":${LAYERDIR}"
BBFILES += "${LAYERDIR}/recipes-*/*/*.bb"
BBFILE_COLLECTIONS += "core"
BBFILE_PATTERN_core = "^${LAYERDIR}/"
BBFILE_PRIORITY_core = "5"
LAYERSERIES_CORENAMES = "wrynose"
LAYERSERIES_COMPAT_core = "wrynose"
```

## tests/fixtures/kas/project/meta-proj-bsp/conf/layer.conf
```bitbake
BBPATH .= ":${LAYERDIR}"
BBFILES += "${LAYERDIR}/recipes-*/*/*.bb ${LAYERDIR}/recipes-*/*/*.bbappend"
BBFILE_COLLECTIONS += "proj-bsp"
BBFILE_PATTERN_proj-bsp = "^${LAYERDIR}/"
BBFILE_PRIORITY_proj-bsp = "10"
LAYERDEPENDS_proj-bsp = "core"
LAYERSERIES_COMPAT_proj-bsp = "wrynose"
```

## tests/fixtures/kas/project/meta-proj-bsp/conf/machine/board1.conf
```bitbake
#@TYPE: Machine
#@NAME: board1
DEFAULTTUNE = "cortexa8hf-neon"
KERNEL_IMAGETYPE = "zImage"
```

## tests/fixtures/kas/project/meta-proj/conf/layer.conf
```bitbake
BBPATH .= ":${LAYERDIR}"
BBFILES += "${LAYERDIR}/recipes-*/*/*.bb ${LAYERDIR}/recipes-*/*/*.bbappend"
BBFILE_COLLECTIONS += "proj"
BBFILE_PATTERN_proj = "^${LAYERDIR}/"
BBFILE_PRIORITY_proj = "10"
LAYERDEPENDS_proj = "core"
LAYERSERIES_COMPAT_proj = "wrynose"
```

## tests/fixtures/lint/org/append-missing-filesextrapaths/base-layer/conf/layer.conf
```bitbake
BBPATH .= ":${LAYERDIR}"

BBFILES += "${LAYERDIR}/recipes-*/*/*.bb \
            ${LAYERDIR}/recipes-*/*/*.bbappend"

BBFILE_COLLECTIONS += "base"
BBFILE_PATTERN_base = "^${LAYERDIR}/"
BBFILE_PRIORITY_base = "5"

LAYERSERIES_COMPAT_base = "wrynose"
```

## tests/fixtures/lint/org/inherit-defer/bad-layer/conf/layer.conf
```bitbake
BBPATH .= ":${LAYERDIR}"

BBFILES += "${LAYERDIR}/recipes-*/*/*.bb \
            ${LAYERDIR}/recipes-*/*/*.bbappend"

BBFILE_COLLECTIONS += "bad"
BBFILE_PATTERN_bad = "^${LAYERDIR}/"
BBFILE_PRIORITY_bad = "6"

LAYERSERIES_COMPAT_bad = "scarthgap wrynose"
```

## tests/fixtures/lint/org/inherit-defer/kirkstone-layer/conf/layer.conf
```bitbake
BBPATH .= ":${LAYERDIR}"

BBFILES += "${LAYERDIR}/recipes-*/*/*.bb \
            ${LAYERDIR}/recipes-*/*/*.bbappend"

BBFILE_COLLECTIONS += "kirk"
BBFILE_PATTERN_kirk = "^${LAYERDIR}/"
BBFILE_PRIORITY_kirk = "6"

LAYERSERIES_COMPAT_kirk = "kirkstone wrynose"
```

## tests/fixtures/lint/org/layer-conf/clash-layer/conf/layer.conf
```bitbake
BBPATH .= ":${LAYERDIR}"

BBFILES += "${LAYERDIR}/recipes-*/*/*.bb \
            ${LAYERDIR}/recipes-*/*/*.bbappend"

BBFILE_COLLECTIONS += "good"
BBFILE_PATTERN_good = "^${LAYERDIR}/"
BBFILE_PRIORITY_good = "6"

LAYERDEPENDS_good = "core"
LAYERSERIES_COMPAT_good = "wrynose"
```

## tests/fixtures/lint/org/layer-conf/copy-layer/conf/layer.conf
```bitbake
BBPATH .= ":${LAYERDIR}"

BBFILES += "${LAYERDIR}/recipes-*/*/*.bb \
            ${LAYERDIR}/recipes-*/*/*.bbappend"

BBFILE_COLLECTIONS += "copy"
BBFILE_PATTERN_copy = "^${LAYERDIR}/"
BBFILE_PRIORITY_copy = "6"

LAYERDEPENDS_copy = "core"
LAYERSERIES_COMPAT_copy = "${LAYERSERIES_COMPAT_core}"
```

## tests/fixtures/lint/org/layer-conf/core-layer/conf/layer.conf
```bitbake
BBPATH .= ":${LAYERDIR}"

BBFILES += "${LAYERDIR}/recipes-*/*/*.bb \
            ${LAYERDIR}/recipes-*/*/*.bbappend"

BBFILE_COLLECTIONS += "core"
BBFILE_PATTERN_core = "^${LAYERDIR}/"
BBFILE_PRIORITY_core = "5"

LAYERSERIES_COMPAT_core = "wrynose"
LAYERSERIES_CORENAMES = "wrynose"
```

## tests/fixtures/lint/org/layer-conf/incompat-layer/conf/layer.conf
```bitbake
BBPATH .= ":${LAYERDIR}"

BBFILES += "${LAYERDIR}/recipes-*/*/*.bb \
            ${LAYERDIR}/recipes-*/*/*.bbappend"

BBFILE_COLLECTIONS += "incompat"
BBFILE_PATTERN_incompat = "^${LAYERDIR}/"
BBFILE_PRIORITY_incompat = "6"

LAYERDEPENDS_incompat = "core"
LAYERSERIES_COMPAT_incompat = "dunfell scarthgapp"
```

## tests/fixtures/lint/org/layer-conf/nocore-layer/conf/layer.conf
```bitbake
BBPATH .= ":${LAYERDIR}"

BBFILES += "${LAYERDIR}/recipes-*/*/*.bb \
            ${LAYERDIR}/recipes-*/*/*.bbappend"

BBFILE_COLLECTIONS += "nocore"
BBFILE_PATTERN_nocore = "^${LAYERDIR}/"
BBFILE_PRIORITY_nocore = "6"

LAYERSERIES_COMPAT_nocore = "scarthgap"
```

## tests/fixtures/lint/org/recipe-path/precision-layer/conf/layer.conf
```bitbake
BBPATH .= ":${LAYERDIR}"

BBFILES += "${LAYERDIR}/recipes-*/*/*.bb \
            ${LAYERDIR}/recipes-*/*/*.bbappend"

BBFILE_COLLECTIONS += "precision"
BBFILE_PATTERN_precision = "^${LAYERDIR}/"
BBFILE_PRIORITY_precision = "6"

LAYERSERIES_COMPAT_precision = "wrynose"
```
